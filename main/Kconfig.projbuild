## main/Kconfig.projbuild
```kconfig
menu "IoT Demo Configuration"

    config IOT_WIFI_SSID
        string "Wi-Fi SSID"
        default ""
        help
            Enter the name of your Wi-Fi network.

    config IOT_WIFI_PASSWORD
        string "Wi-Fi Password"
        default ""
        help
            Enter your Wi-Fi password.
            Keep the generated sdkconfig file private.

    config IOT_MQTT_BROKER_URI
        string "MQTT Broker URI"
        default ""
        help
            Enter the MQTT broker URI.
            For example: mqtt://broker.example.com:1883

    config IOT_MQTT_TOPIC
        string "MQTT Topic"
        default "esp32/bme280/telemetry"
        help
            MQTT topic used to publish environmental
            sensor measurements.

endmenu
```
